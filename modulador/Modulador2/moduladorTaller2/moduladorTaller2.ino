// ResumenPorBit.ino  (ESp32 - sin Serial.printf)
#include <Arduino.h>

const float Fs = 8000.0f; //Remuestreo a 8k
const float Tb = 0.01f; //duración del bit
const int N = int(round(Tb * Fs));
const float f1 = 800.0f;
const float f2 = 1600.0f;
const int dacPin = 25;
const uint8_t DAC_OFFSET = 128;
const uint8_t AMP = 100;

// --- Secuencia de bits de ejemplo utilizado en modulador.py---
const uint16_t NUM_BITS = 1003;
uint8_t bits[NUM_BITS] = {0,1,1,0,1,1,1,0,1,1,1,1,0,0,1,1,
1,1,1,1,0,0,1,1,0,1,1,0,0,1,0,1,0,0,1,0,1,0,1,0,1,1,1,1,1,
0,0,1,0,1,1,0,0,0,1,1,1,1,0,1,0,0,0,0,1,0,1,1,1,1,0,1,0,0,
1,0,0,1,1,0,1,1,1,1,0,0,0,0,0,0,1,0,1,0,1,1,0,0,0,1,0,1,1,
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0,1,0,1,0,1,0,1,0,1,0,0,1,0,1,0,0,0,1,1,0,1,1,0};

void setup() {
  Serial.begin(115200);
  delay(200);
  Serial.println("Resumen por bit - mostrando primeras 8 muestras de cada bit");

  // Precomputar portadoras
  float port1[N], port2[N];
  for (int n = 0; n < N; ++n) {
    float t = float(n) / Fs;
    //Genera dos arrays de muestras (port1 y port2) que representan una onda cosenoidal para f1 y f2
    port1[n] = cos(2.0 * PI * f1 * t);
    port2[n] = cos(2.0 * PI * f2 * t);
  }

  // Para cada bit, imprime solo primeras M muestras
  const int M = 8; // muestras a imprimir por bit (ajusta)
  for (int b = 0; b < NUM_BITS; ++b) {
    Serial.print("Bit ");
    Serial.print(b);
    Serial.print(": ");
    Serial.println(bits[b]);

    for (int n = 0; n < M; ++n) {
      int value;
      if (bits[b] == 0) value = int(DAC_OFFSET + AMP * port1[n]);
      else value = int(DAC_OFFSET + AMP * port2[n]);

      // escribir DAC (opcional)
      //dacWrite(dacPin, constrain(value, 0, 255));
      // imprimir muestra reducida
      Serial.print(value);
      if (n < M - 1) Serial.print(',');
    }
    Serial.println();
    // esperar al final del bit
    delay((int)(Tb * 1000)); // espera Tb en ms (10 ms)
  }

  Serial.println("Fin de resumen.");
}

void loop() {
  // nada
}
